## conf/layer.conf
```bitbake
#
# Copyright (C) 2018-2019 Wind River Systems, Inc.
#

# We have a conf and classes directory, add to BBPATH
BBPATH =. "${LAYERDIR}:"

# We have a packages directory, add to BBFILES
BBFILES += "${LAYERDIR}/recipes-*/*/*.bb \
	${LAYERDIR}/recipes-*/*/*.bbappend"

BBFILE_COLLECTIONS += "wr-renesas-rcar"
BBFILE_PATTERN_wr-renesas-rcar := "^${LAYERDIR}/"
BBFILE_PRIORITY_wr-renesas-rcar = "7"

# This should only be incremented on significant changes that will
# cause compatibility issues with other layers
LAYERVERSION_wr-renesas-rcar = "1"

LAYERDEPENDS_wr-renesas-rcar = "core wrlinux"

LAYERSERIES_COMPAT_wr-renesas-rcar = "wrl warrior"
```

## conf/machine/renesas-rcar-h3.conf
```bitbake
#@TYPE: Machine
#@NAME: renesas-rcar-h3
#@DESCRIPTION: Machine configuration for Renesas R-Car H3 SoC

SOC_FAMILY = "r8a7795"

require renesas-rcar.inc

MACHINEOVERRIDES .= ":h3ulcb"

KERNEL_DEVICETREE = " \
    renesas/r8a7795-h3ulcb.dtb \
    renesas/r8a7795-es1-h3ulcb.dtb \
    renesas/r8a7795-h3ulcb-kf.dtb \
    renesas/r8a7795-es1-h3ulcb-kf.dtb \
"

# H3ULCB u-boot configure
UBOOT_CONFIG ??= "h3ulcb h3ulcb-4x2g"
UBOOT_CONFIG[h3ulcb] = "r8a7795_ulcb_defconfig"
UBOOT_CONFIG[h3ulcb-4x2g] = "r8a7795_ulcb-4x2g_defconfig"

# H3ULCB wic
IMAGE_BOOT_FILES ?= "Image r8a7795-h3ulcb.dtb r8a7795-es1-h3ulcb.dtb r8a7795-h3ulcb-kf.dtb r8a7795-es1-h3ulcb-kf.dtb"
```

## conf/machine/renesas-rcar-m3.conf
```bitbake
#@TYPE: Machine
#@NAME: renesas-rcar-m3
#@DESCRIPTION: Machine configuration for Renesas R-Car M3 SoC

SOC_FAMILY = "r8a7796"

require renesas-rcar.inc

KERNEL_DEVICETREE = " \
    renesas/r8a7796-m3ulcb.dtb \
    renesas/r8a7796-m3ulcb-kf.dtb \
"

# M3ULCB u-boot configure
UBOOT_MACHINE = "r8a7796_ulcb_defconfig"

# M3ULCB wic
IMAGE_BOOT_FILES ?= "Image r8a7796-m3ulcb.dtb r8a7796-m3ulcb-kf.dtb"
```

## conf/machine/renesas-rcar.inc
```bitbake
DEFAULTTUNE ?= "cortexa57-cortexa53"
require conf/machine/include/tune-cortexa57-cortexa53.inc
require conf/machine/include/${SOC_FAMILY}.inc

MACHINE_FEATURES += "ext3 pci usbgadget usbhost vfat alsa network"

KERNEL_IMAGETYPE = ""
KERNEL_IMAGETYPES = "Image.gz Image"

SERIAL_CONSOLE = "115200 ttySC0"

MACHINEOVERRIDES .= ":ulcb"

# wic
WIC_CREATE_EXTRA_ARGS = "--no-fstab-update"
MACHINE_EXTRA_RRECOMMENDS = " kernel-modules kernel-devicetree"
IMAGE_FSTYPES += "tar.bz2 wic wic.bmap"
WKS_FILE ?= "renesas-rcar-sdimage.wks"
IMAGE_INSTALL_append = " kernel-devicetree kernel-image-image"
do_image_wic[depends] += "mtools-native:do_populate_sysroot dosfstools-native:do_populate_sysroot"

# multilib support
MULTILIBS ?= "multilib:lib32"
DEFAULTTUNE_virtclass-multilib-lib32 ?= "armv7athf-neon"

PREFERRED_PROVIDER_virtual/kernel ??= "linux-yocto"
PREFERRED_VERSION_linux-yocto ?= "5.0%"
```

## rcar-multimedia/conf/layer.conf
```bitbake
#
# Copyright (C) 2018-2019 Wind River Systems, Inc.
#

# We have a conf and classes directory, add to BBPATH
BBPATH .= ":${LAYERDIR}"

require renesas-rcar-multimedia.inc

# We have a packages directory, add to BBFILES
BBFILES += "${LAYERDIR}/recipes-*/*/*.bb \
	${LAYERDIR}/recipes-*/*/*.bbappend \
	${LAYERDIR}/classes/*.bbclass"

BBFILE_COLLECTIONS += "rcar-multimedia-layer"
BBFILE_PATTERN_rcar-multimedia-layer := "^${LAYERDIR}/"
BBFILE_PRIORITY_rcar-multimedia-layer = "7"

MACHINE_SOCARCH_r8a7795 = "renesas_rcar_h3"
MACHINE_SOCARCH_r8a7796 = "renesas_rcar_m3"

BANNER[renesas-rcar] = "The renesas-rcar-multimedia layer includes third party components, where additional third party licenses may apply."

LAYERSERIES_COMPAT_rcar-multimedia-layer = "thud"
```
